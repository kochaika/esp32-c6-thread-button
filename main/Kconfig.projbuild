## main/Kconfig.projbuild
```kconfig
menu "Example Configuration"

    config ENABLE_MEMORY_PROFILING
        bool "Enable Memory Profiling"
        default n
        help
            Enable this option to include memory profiling features in the example.
            This will allow you to monitor memory usage during runtime.

    config BUTTON_GPIO
        int "Button GPIO"
        range 0 30
        default 0
        help
            GPIO used by the first active-low button. The default is XIAO
            ESP32-C6 D0/GPIO0.

    config BUTTON2_GPIO
        int "Second Button GPIO"
        range 0 30
        default 2
        help
            GPIO used by the second active-low button. The default is XIAO
            ESP32-C6 D2/GPIO2.

    config BATTERY_ADC_GPIO
        int "Battery sense ADC GPIO"
        range 0 6
        default 1
        help
            ADC1-capable GPIO connected to the midpoint of the battery voltage
            divider. Must be an ADC1 channel (GPIO0-GPIO6 on ESP32-C6). The
            default is XIAO ESP32-C6 D1/GPIO1.

endmenu
```

## sdkconfig.defaults.c6_thread
```kconfig
CONFIG_IDF_TARGET="esp32c6"

# libsodium
CONFIG_LIBSODIUM_USE_MBEDTLS_SHA=y

# NIMBLE
CONFIG_BT_ENABLED=y
CONFIG_BT_NIMBLE_ENABLED=y
CONFIG_BT_NIMBLE_EXT_ADV=n
CONFIG_BT_NIMBLE_HCI_EVT_BUF_SIZE=70
CONFIG_BT_LE_SLEEP_ENABLE=y
CONFIG_USE_BLE_ONLY_FOR_COMMISSIONING=y
CONFIG_ESP_PHY_MAC_BB_PD=y

# Power Management
CONFIG_PM_ENABLE=y
CONFIG_PM_DFS_INIT_AUTO=y
CONFIG_PM_POWER_DOWN_PERIPHERAL_IN_LIGHT_SLEEP=y

# FreeRTOS
CONFIG_FREERTOS_HZ=1000
CONFIG_FREERTOS_ENABLE_BACKWARD_COMPATIBILITY=y
CONFIG_FREERTOS_USE_TICKLESS_IDLE=y

# Enable OpenThread
CONFIG_OPENTHREAD_ENABLED=y
CONFIG_OPENTHREAD_SRP_CLIENT=y
CONFIG_OPENTHREAD_DNS_CLIENT=y
CONFIG_OPENTHREAD_LOG_LEVEL_DYNAMIC=n
CONFIG_OPENTHREAD_LOG_LEVEL_NOTE=y
CONFIG_OPENTHREAD_MTD=y
CONFIG_OPENTHREAD_CLI=n

# IEEE802.15.4
CONFIG_IEEE802154_SLEEP_ENABLE=y

# Disable lwip ipv6 autoconfig
CONFIG_LWIP_IPV6_AUTOCONFIG=n

# Use a custom partition table
CONFIG_PARTITION_TABLE_CUSTOM=y
CONFIG_PARTITION_TABLE_CUSTOM_FILENAME="partitions.csv"

# LwIP config for OpenThread
CONFIG_LWIP_ND6=n
CONFIG_LWIP_IPV4=n
CONFIG_LWIP_IPV6_NUM_ADDRESSES=8
CONFIG_LWIP_MULTICAST_PING=y

# MDNS platform
CONFIG_USE_MINIMAL_MDNS=n
CONFIG_ENABLE_EXTENDED_DISCOVERY=y

# Enable OTA Requestor
CONFIG_ENABLE_OTA_REQUESTOR=y

# IPv6-only Matter over Thread
CONFIG_DISABLE_IPV4=y

# MbedTLS
CONFIG_MBEDTLS_SSL_PROTO_DTLS=y

# ICD Server, LIT profile
CONFIG_ENABLE_ICD_SERVER=y
CONFIG_ICD_SLOW_POLL_INTERVAL_MS=20000
CONFIG_ICD_FAST_POLL_INTERVAL_MS=500
CONFIG_ICD_IDLE_MODE_INTERVAL_SEC=600
CONFIG_ICD_ACTIVE_MODE_INTERVAL_MS=1000
CONFIG_ICD_ACTIVE_MODE_THRESHOLD_MS=5000
CONFIG_ENABLE_ICD_LIT=y
CONFIG_ICD_CLIENTS_SUPPORTED_PER_FABRIC=2
CONFIG_ICD_MAX_NOTIFICATION_SUBSCRIBERS=2
CONFIG_SUPPORT_ICD_MANAGEMENT_CLUSTER=y

# Disable STA for ESP32C6
CONFIG_ENABLE_WIFI_STATION=n

# Button
CONFIG_BUTTON_PERIOD_TIME_MS=20
CONFIG_BUTTON_LONG_PRESS_TIME_MS=2500
CONFIG_BUTTON_GPIO=0
CONFIG_GPIO_BUTTON_SUPPORT_POWER_SAVE=y

# Disable chip shell
CONFIG_ENABLE_CHIP_SHELL=n

# ESP32-C6-DevKitM-1 Settings
# Buttons
CONFIG_BSP_BUTTONS_NUM=1
CONFIG_BSP_BUTTON_1_TYPE_GPIO=y
CONFIG_BSP_BUTTON_1_GPIO=0
CONFIG_BSP_BUTTON_1_LEVEL=0
# LEDs
CONFIG_BSP_LEDS_NUM=1
CONFIG_BSP_LED_TYPE_RGB=y
CONFIG_BSP_LED_RGB_GPIO=8
CONFIG_BSP_LED_RGB_BACKEND_RMT=y
```
